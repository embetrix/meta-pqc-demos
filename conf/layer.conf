## conf/layer.conf
```bitbake
# We have a conf and classes directory, add to BBPATH
BBPATH .= ":${LAYERDIR}"

# We have a packages directory, add to BBFILES
BBFILES += "${LAYERDIR}/recipes-*/*/*.bb \
            ${LAYERDIR}/recipes-*/*/*.bbappend"

BBFILE_COLLECTIONS += "pqc-demos"
BBFILE_PATTERN_pqc-demos := "^${LAYERDIR}/"
BBFILE_PRIORITY_pqc-demos = "9"
LAYERSERIES_COMPAT_pqc-demos = "wrynose"
LAYERDEPENDS_pqc-demos = "core openembedded-layer security integrity"

PQC_DEMOS_BASE := '${LAYERDIR}'
```
